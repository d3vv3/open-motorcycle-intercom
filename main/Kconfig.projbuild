## main/Kconfig.projbuild
```kconfig
menu "OMI mesh settings"

    config OMI_MESH_CHANNEL
        int "Talk channel (1 green, 2 red, 3 blue)"
        range 1 3
        default 1
        help
            Select the fixed talk group and radio channel at boot.
            ESP-NOW uses channels 1/6/11; nRF ESB uses 40/20/60.

endmenu
```
